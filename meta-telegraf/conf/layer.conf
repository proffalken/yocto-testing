## meta-telegraf/conf/layer.conf
```bitbake
# We have a conf and classes directory, add to BBPATH
BBPATH .= ":${LAYERDIR}"

# We have recipes-* directories, add to BBFILES
BBFILES += "${LAYERDIR}/recipes-*/*/*.bb \
            ${LAYERDIR}/recipes-*/*/*.bbappend"

BBFILE_COLLECTIONS += "meta-telegraf"
BBFILE_PATTERN_meta-telegraf = "^${LAYERDIR}/"
BBFILE_PRIORITY_meta-telegraf = "6"

LAYERDEPENDS_meta-telegraf = "core"
LAYERSERIES_COMPAT_meta-telegraf = "thud warrior"
```
